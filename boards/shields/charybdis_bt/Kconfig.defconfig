## boards/shields/charybdis_bt/Kconfig.defconfig
```kconfig
if SHIELD_CHARYBDIS_RIGHT

config ZMK_KEYBOARD_NAME
	default "Charybdis"

config ZMK_SPLIT_BLE_ROLE_CENTRAL
	default y

config SPI
	default y

config INPUT
	default y

config PMW3610
	default y

endif

if SHIELD_CHARYBDIS_LEFT || SHIELD_CHARYBDIS_RIGHT

config ZMK_SPLIT
	default y
	
endif
```

## config/west.yml
```yaml
manifest:
  remotes:
    - name: urob
      url-base: https://github.com/urob

    - name: badjeff
      url-base: https://github.com/badjeff

  projects:
    - name: zmk
      remote: urob
      revision: main
      import: app/west.yml

    - name: zmk-pmw3610-driver
      remote: badjeff
      revision: main
      path: pmw3610

  self:
    path: config
```
